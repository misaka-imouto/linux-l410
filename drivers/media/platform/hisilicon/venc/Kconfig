## drivers/media/platform/hisilicon/venc/Kconfig
```kconfig
# SPDX-License-Identifier: GPL-2.0-only
config VIDEO_HISI_VENC
	tristate "HiSilicon Kirin 990 video encoder"
	depends on V4L_MEM2MEM_DRIVERS
	depends on VIDEO_DEV
	depends on ARCH_HISI || COMPILE_TEST
	select MEDIA_CONTROLLER
	select VIDEOBUF2_DMA_SG
	select V4L2_MEM2MEM_DEV
	select IOMMU_IO_PGTABLE_LPAE
	select GENERIC_ALLOCATOR
	help
	  Stateful V4L2 mem2mem video encoder for the VEDU block of the HiSilicon
	  Kirin 990 video codec (VCodec V500). Supports H.264 and HEVC (H.265).

	  To compile this driver as a module, choose M here: the module
	  will be called hisi-venc.
```

## drivers/misc/huawei-fingerprint/Kconfig
```kconfig
# SPDX-License-Identifier: GPL-2.0
config HUAWEI_FINGERPRINT
	tristate "Huawei Qingyun L410 / Kirin 990 Fingerprint Sensor Bridge Driver"
	default y
	depends on ARM64
	help
	  This driver provides support for the Fingerprint Cards (FPC) sensor
	  on Huawei Qingyun L410 (KLVU-WDU0B) / Kirin 990, creating the
	  /dev/fingerprint device node and sysfs attributes for power, reset,
	  and interrupt notifications.

	  If unsure, say Y.
```

## drivers/tee/itrustee/Kconfig
```kconfig
# SPDX-License-Identifier: GPL-2.0
config TZDRIVER
	tristate "Huawei iTrustee OS TrustZone client driver"
	default y
	depends on ARM64
	help
	  This driver provides support for communicating with Huawei iTrustee
	  Secure OS running in ARM TrustZone, creating the /dev/tc_ns_client device node.
	  It is required for the hardware fingerprint sensor, security enclaves,
	  and DRM protected media pipelines on Kirin 990 / Huawei Qingyun L410.

	  If unsure, say Y.
```
